## components/gps_time/Kconfig
```kconfig
menu "GPS Time Component"
    config GPS_TIME_SYNC
        bool "Enable GPS time sync with SparkFun SAM-M8Q"
        default y
        help
            When enabled, the firmware will periodically sync the time using
            the GPS time that the SparkFun SAM-M8Q GPS receiver receives.
    config GPS_TIME_LAG
        int "Number of valid GPS timestamps until setting the time of day"
        default 60
        depends on GPS_TIME_SYNC
        help
            Setting this number too high will result in inaccurate time of
            day.

            Setting this number too low will result in syncing time too
            often.
endmenu
```

## components/iic_mux/Kconfig
```kconfig
menu "I2C Multiplexing Component"
    config I2CMUX_BME280
        bool "Enable BME280 Sensor"
        default true
        help
            Enables the MicroMod's BME280 sensor
endmenu
```

## components/wireless/Kconfig
```kconfig
menu "Wireless Component"
    config WIRELESS_JOIN_SSID
        string "The SSID of the Wi-Fi network to join"
        default ""
    config WIRELESS_JOIN_PASSPHRASE
        string "The passphrase of the Wi-Fi network to join"
        default ""
    choice WIRELESS_SECURITY
         prompt "The Wi-Fi security level to scan and join"
         default WIRELESS_SECURITY_WPA_WPA2_PSK
         config WIRELESS_SECURITY_OPEN
            bool "No security level"
         config WIRELESS_SECURITY_WEP
            bool "WEP security level"
         config WIRELESS_SECURITY_WPA_PSK
            bool "WPA security level"
         config WIRELESS_SECURITY_WPA2_PSK
            bool "WPA2 security level"
         config WIRELESS_SECURITY_WPA_WPA2_PSK
            bool "WPA/WPA2 security level"
    endchoice
    config WIRELESS_AUTO_UPDATE
        bool "Enable automatic updates"
        default false
        help
            You probably should be signing your app binaries if you enable this
   config WIRELESS_RETRIES
      int "How many times to try joining the Wi-Fi network before stopping"
      default 5
endmenu
```
